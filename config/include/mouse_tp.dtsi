/*
 * ThinkPad 小红点 (PS/2 TrackPoint) 配置
 * 仅在 keymap 中 #define HAS_MOUSE_TP 且 overlay 中定义 MOUSE_PS2_DT_PRESENT 时生效。
 */
#ifdef HAS_MOUSE_TP
#ifdef MOUSE_PS2_DT_PRESENT

&mouse_ps2_input_listener {
    layer-toggle = <1>;
    layer-toggle-delay-ms = <200>;
    /* 停止移动后保持 800ms，左/中/右键更好触发 */
    layer-toggle-timeout-ms = <800>;
    y-invert;
};

&mouse_ps2 {
    status = "okay";
    /* 灵敏度：默认 128，可改为 80–200；运行时用按键 &mms MS_TP_SENSITIVITY_INCR/DECR 调节 */
    tp-sensitivity = <128>;
};

&mouse_ps2_input_listener {
    status = "okay";
};

&uart0 {
    status = "okay";
};

&uart_ps2 {
    status = "okay";
};

#endif
#endif
