/*
 * ThinkPad 小红点 (PS/2 TrackPoint) 配置
 * 仅在 keymap 中 #define HAS_MOUSE_TP 且 overlay 中定义 MOUSE_PS2_DT_PRESENT 时生效。
 */
#ifdef HAS_MOUSE_TP
#ifdef MOUSE_PS2_DT_PRESENT

&mouse_ps2_input_listener {
    layer-toggle = <1>;
    layer-toggle-delay-ms = <250>;
    layer-toggle-timeout-ms = <250>;
    /* 上下方向反了时启用 */
    y-invert;
};

&mouse_ps2 {
    status = "okay";
    /* 灵敏度：默认 128，可改为 80–200，越大越快；运行时可用按键 &mms MS_TP_SENSITIVITY_INCR/DECR 调节 */
    tp-sensitivity = <128>;
    /* 可选：最大速度 tp-val6-upper-speed = <97>; 负惯性 tp-neg-inertia = <6>; */
};

&mouse_ps2_input_listener {
    status = "okay";
};

&uart0 {
    status = "okay";
};

&uart_ps2 {
    status = "okay";
};

#endif
#endif
