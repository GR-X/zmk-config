## boards/shields/matrix_7x15/Kconfig.defconfig
```kconfig
# Copyright (c) 2025
# SPDX-License-Identifier: MIT

if SHIELD_MATRIX_7X15

config ZMK_KEYBOARD_NAME
    default "Matrix 7x15"

config ZMK_POINTING
    default y

endif
```

## boards/shields/matrix_7x15/Kconfig.shield
```kconfig
# Copyright (c) 2025
# SPDX-License-Identifier: MIT

config SHIELD_MATRIX_7X15
    def_bool $(shields_list_contains,matrix_7x15)
```

## config/west.yml
```yaml
manifest:
  remotes:
    - name: zmkfirmware
      url-base: https://github.com/zmkfirmware
    - name: infused-kim
      url-base: https://github.com/infused-kim
  projects:
    # 使用带鼠标/指点设备支持的 ZMK fork（PR #2027）
    - name: zmk
      remote: infused-kim
      revision: pr-testing/mouse_ps2_module_base
      import: app/west.yml
    # PS/2 鼠标与 ThinkPad 小红点驱动模块
    - name: kb_zmk_ps2_mouse_trackpoint_driver
      remote: infused-kim
      revision: main
  self:
    path: config
```
